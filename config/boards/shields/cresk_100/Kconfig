## config/boards/shields/cresk_100/Kconfig
```kconfig
# Copyright (c) 2022 The ZMK Contributors
# SPDX-License-Identifier: MIT

if ZMK_DISPLAY

config CUSTOM_WIDGET_LABEL
	bool "Widget for displaying text"
	select LVGL_USE_LABEL

if CUSTOM_WIDGET_LABEL

config CUSTOM_WIDGET_LABEL_TEXT
	string "Label text"
	default ZMK_KEYBOARD_NAME

endif # CUSTOM_WIDGET_LABEL

config CUSTOM_WIDGET_BONGO_CAT
	bool "Widget for displaying bongo cat"
	select LVGL_USE_LABEL
	select LVGL_USE_IMG

endif # ZMK_DISPLAY
```

## config/boards/shields/cresk_100/Kconfig.defconfig
```kconfig
# Copyright (c) 2022 The ZMK Contributors
# SPDX-License-Identifier: MIT

if SHIELD_CRESK_100 || SHIELD_CRESK_V2

config ZMK_KEYBOARD_NAME
	default "cresk_100" if SHIELD_CRESK_100
	default "cresk_v2" if SHIELD_CRESK_V2

config ZMK_USB
	default y

choice ZMK_DISPLAY_STATUS_SCREEN
	default ZMK_DISPLAY_STATUS_SCREEN_CUSTOM

endchoice

if ZMK_DISPLAY

config I2C
	default y

config SSD1306
	default y

config SSD1306_REVERSE_MODE
	default y

if ZMK_DISPLAY_STATUS_SCREEN_CUSTOM

config LV_FONT_MONTSERRAT_16
	default y

choice LV_FONT_DEFAULT
	default LV_FONT_DEFAULT_MONTSERRAT_16

endchoice

config LV_FONT_MONTSERRAT_12
	default y

choice ZMK_LV_FONT_DEFAULT_SMALL
	prompt "Select theme default small font"
	default ZMK_LV_FONT_DEFAULT_SMALL_MONTSERRAT_12

	config ZMK_LV_FONT_DEFAULT_SMALL_MONTSERRAT_8
		bool "Montserrat 8"
		select LV_FONT_MONTSERRAT_8
	config ZMK_LV_FONT_DEFAULT_SMALL_MONTSERRAT_12
		bool "Montserrat 12"
		select LV_FONT_MONTSERRAT_12
endchoice

endif # ZMK_DISPLAY_STATUS_SCREEN_CUSTOM

config CUSTOM_WIDGET_LABEL
	bool "Widget for displaying text"
	select LV_USE_LABEL

if CUSTOM_WIDGET_LABEL

config CUSTOM_WIDGET_LABEL_TEXT
	string "Label text"
	default ZMK_KEYBOARD_NAME

endif # CUSTOM_WIDGET_LABEL

config CUSTOM_WIDGET_BONGO_CAT
	bool "Widget for displaying bongo cat"
	select LV_USE_LABEL
	select LV_USE_IMG

endif # ZMK_DISPLAY

if LVGL

config LV_Z_VDB_SIZE
	default 64

config LV_Z_DPI
	default 148

config LV_Z_BITS_PER_PIXEL
	default 1

choice LV_COLOR_DEPTH
	default LV_COLOR_DEPTH_1
endchoice

endif # LVGL

if BUILD_OUTPUT_UF2

config BUILD_OUTPUT_UF2_FAMILY_ID
	default "0x57755a57"

config BUILD_OUTPUT_UF2_USE_FLASH_BASE
	default y

config BUILD_OUTPUT_UF2_USE_FLASH_OFFSET
	default y

endif # BUILD_OUTPUT_UF2

endif # SHIELD_CRESK_100 || SHIELD_CRESK_V2
```

## config/boards/shields/cresk_100/Kconfig.shield
```kconfig
# Copyright (c) 2022 The ZMK Contributors
# SPDX-License-Identifier: MIT

config SHIELD_CRESK_100
	def_bool $(shields_list_contains,cresk_100)

config SHIELD_CRESK_V2
	def_bool $(shields_list_contains,cresk_v2)
```

## config/west.yml
```yaml
manifest:
  remotes:
    - name: zmkfirmware
      url-base: https://github.com/zmkfirmware
    - name: nguyendown
      url-base: https://github.com/nguyendown
  projects:
    - name: zmk
      remote: nguyendown
      revision: shield-code+charlieplex+sk-fixes+mouse+sensor-binding
      import: app/west.yml
  self:
    path: config
```
